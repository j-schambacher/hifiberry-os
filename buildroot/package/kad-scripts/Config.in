## buildroot/package/kad-scripts/Config.in
```kconfig
config BR2_PACKAGE_KAD_SCRIPTS
	bool "KAD scripts (WiSA startup etc.)"
        help
	  Installs the necessary WiSA control scripts
        depends on BR2_PACKAGE_PYTHON_WISA
```
